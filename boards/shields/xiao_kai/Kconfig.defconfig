## boards/shields/xiao_kai/Kconfig.defconfig
```kconfig
if SHIELD_XIAO_KAI_LEFT

config ZMK_KEYBOARD_NAME
    default "Xiao Kai"

config ZMK_SPLIT_ROLE_CENTRAL
    default y

endif

if SHIELD_XIAO_KAI_LEFT || SHIELD_XIAO_KAI_RIGHT

config ZMK_SPLIT
    default y

endif
```

## boards/shields/xiao_kai/Kconfig.shield
```kconfig
config SHIELD_XIAO_KAI_LEFT
    def_bool $(shields_list_contains,xiao_kai_left)

config SHIELD_XIAO_KAI_RIGHT
    def_bool $(shields_list_contains,xiao_kai_right)
```
